## CMakeLists.txt
```
#
# Copyright (c) 2022 Nordic Semiconductor ASA
#
# SPDX-License-Identifier: LicenseRef-Nordic-5-Clause
#

cmake_minimum_required(VERSION 3.20.0)

find_package(Zephyr REQUIRED HINTS $ENV{ZEPHYR_BASE})
project(kid_gps_tracker)
zephyr_compile_definitions(PROJECT_NAME=${PROJECT_NAME})

# Include certs files if enabled.
zephyr_include_directories_ifdef(CONFIG_NRF_CLOUD_PROVISION_CERTIFICATES certs)

# NORDIC SDK APP START
target_sources(app PRIVATE src/main.c)
target_sources(app PRIVATE src/application.c)
target_sources(app PRIVATE src/cloud_connection.c)
target_sources(app PRIVATE src/message_queue.c)
target_sources(app PRIVATE src/temperature.c)
target_sources(app PRIVATE src/fota_support.c)
target_sources(app PRIVATE src/led_control.c)
target_sources(app PRIVATE src/sample_reboot.c)
target_sources(app PRIVATE src/shadow_config.c)

if(CONFIG_LOCATION_TRACKING)
target_sources(app PRIVATE src/location_tracking.c)
endif()

if(CONFIG_COAP_SHADOW)
target_sources(app PRIVATE src/shadow_support_coap.c)
endif()

if(CONFIG_COAP_FOTA)
target_sources(app PRIVATE src/fota_support_coap.c)
endif()

if(CONFIG_NRF_PROVISIONING)
target_sources(app PRIVATE src/provisioning_support.c)
endif()

# Include modem-specific features if supported
if(CONFIG_NRF_MODEM_LIB)
	target_sources(app PRIVATE src/at_commands.c)
endif()

# NORDIC SDK APP END

zephyr_include_directories(src)
```

## prj.conf
```kconfig
#
# Copyright (c) 2022 Nordic Semiconductor ASA
#
# SPDX-License-Identifier: LicenseRef-Nordic-5-Clause
#

# Log level
# For more verbose and detailed log output, set the log level to
# CONFIG_MULTI_SERVICE_LOG_LEVEL_DBG=y instead.
CONFIG_MULTI_SERVICE_LOG_LEVEL_INF=y

# General config
CONFIG_EVENTS=y
CONFIG_PICOLIBC_IO_FLOAT=y
CONFIG_RESET_ON_FATAL_ERROR=y
CONFIG_NCS_SAMPLES_DEFAULTS=y
CONFIG_DK_LIBRARY=y

# LED indication
# Uncomment these to minimize LED state indication when power savings are necessary
# CONFIG_LED_VERBOSE_INDICATION=n
# CONFIG_LED_CONTINUOUS_INDICATION=n

# Or, uncomment this to completely disable LED state indication
# CONFIG_LED_INDICATION_DISABLED=y

# Improved Logging
# CONFIG_LOG_MODE_DEFERRED allows logging from multiple threads simultaneously without creating
# splintered log entries, at the cost of needing a buffer for storing logs.
CONFIG_LOG_MODE_DEFERRED=y

# CONFIG_LOG_BUFFER_SIZE is the aforementioned buffer. A size of 4096 bytes is useful for debugging
# and prototyping, but is probably more than necessary for production-ready firmware.
CONFIG_LOG_BUFFER_SIZE=4096

# Heap and stacks
# Extended AT host/monitor stack/heap sizes since some nrf_cloud credentials are longer than 1024 bytes.
CONFIG_AT_MONITOR_HEAP_SIZE=2048
CONFIG_AT_HOST_STACK_SIZE=2048
# Extended memory heap size needed both for PGPS and for encoding JSON-based nRF Cloud Device Messages.
CONFIG_HEAP_MEM_POOL_SIZE=19000
CONFIG_SYSTEM_WORKQUEUE_STACK_SIZE=4096
# The default modem shared memory buffer for TX is significantly larger than required.
# RX buffer has to be larger because the sample reads certificates so using default value.
CONFIG_NRF_MODEM_LIB_SHMEM_TX_SIZE=4096

# Enable Networking and Connection Manager.
CONFIG_NETWORKING=y
CONFIG_NET_SOCKETS=y
CONFIG_NET_SOCKETS_OFFLOAD=y
CONFIG_NET_MGMT_EVENT_STACK_SIZE=2048
CONFIG_NET_CONNECTION_MANAGER_MONITOR_STACK_SIZE=1024
CONFIG_MAIN_STACK_SIZE=2048

# Enable LTE Connectivity using Connection Manager
CONFIG_NET_IPV4=y
CONFIG_NET_IPV6=y
CONFIG_NET_IPV6_NBR_CACHE=n
CONFIG_NET_IPV6_MLD=n
CONFIG_NET_CONNECTION_MANAGER=y
CONFIG_NRF_MODEM_LIB_NET_IF=y
CONFIG_NRF_MODEM_LIB_NET_IF_AUTO_DOWN=y
CONFIG_NRF_MODEM_LIB_NET_IF_DOWN_DEFAULT_LTE_DISCONNECT=y

# Enable power savings mode
CONFIG_LTE_PSM_REQ=y
# Set the PSM Requested Active Time to 20 seconds
CONFIG_LTE_PSM_REQ_RAT="00001010"

# Modem library
CONFIG_NRF_MODEM_LIB=y

# AT commands interface
CONFIG_UART_INTERRUPT_DRIVEN=y
CONFIG_AT_HOST_LIBRARY=y

# Wait for credential installation to be complete before connecting to nRF Cloud
CONFIG_NRF_CLOUD_CHECK_CREDENTIALS=y

# nRF Cloud
CONFIG_NRF_CLOUD_MQTT=y # This also enables FOTA by implicitly setting CONFIG_NRF_CLOUD_FOTA=y

# MQTT
CONFIG_MQTT_KEEPALIVE=120

# MCUBOOT - Needed by FOTA
CONFIG_BOOTLOADER_MCUBOOT=y
CONFIG_IMG_MANAGER=y
CONFIG_MCUBOOT_IMG_MANAGER=y
CONFIG_STREAM_FLASH_ERASE=y

# Location Services configuration
CONFIG_LOCATION=y
CONFIG_LOCATION_METHOD_GNSS=y
CONFIG_LOCATION_METHOD_CELLULAR=y
CONFIG_NRF_CLOUD_AGNSS=y
CONFIG_NRF_CLOUD_LOCATION=y
CONFIG_MODEM_INFO=y
CONFIG_MODEM_INFO_ADD_NETWORK=y
CONFIG_NRF_CLOUD_PGPS=y
CONFIG_NRF_CLOUD_PGPS_REPLACEMENT_THRESHOLD=4
CONFIG_NRF_CLOUD_PGPS_REQUEST_UPON_INIT=y

# GNSS priority mode: LTE is released during GNSS fix to give full antenna access
CONFIG_LOCATION_REQUEST_DEFAULT_GNSS_PRIORITY_MODE=y
CONFIG_GNSS_FIX_TIMEOUT_SECONDS=90

# Date Time lib - Used by PGPS and main application
CONFIG_DATE_TIME=y

# LTE link control - used by PGPS and main application
CONFIG_LTE_LINK_CONTROL=y
CONFIG_LTE_LC_EDRX_MODULE=y
CONFIG_LTE_LC_PSM_MODULE=y

# Settings - used by nRF Cloud library and PGPS
CONFIG_SETTINGS=y
CONFIG_SETTINGS_FCB=y
CONFIG_FCB=y

# Download Client - used by FOTA and PGPS
CONFIG_DOWNLOAD_CLIENT=y
CONFIG_DOWNLOAD_CLIENT_HTTP_FRAG_SIZE_1024=y
CONFIG_DOWNLOAD_CLIENT_STACK_SIZE=4096
CONFIG_DOWNLOAD_CLIENT_BUF_SIZE=2300
CONFIG_DOWNLOAD_CLIENT_MAX_HOSTNAME_SIZE=128

# Flash - Used by FOTA and PGPS
CONFIG_FLASH=y
CONFIG_FLASH_PAGE_LAYOUT=y
CONFIG_FLASH_MAP=y
CONFIG_STREAM_FLASH=y
CONFIG_MPU_ALLOW_FLASH_WRITE=y
CONFIG_PM_EXTERNAL_FLASH_MCUBOOT_SECONDARY=n
CONFIG_NRF_CLOUD_ALERT=y
CONFIG_NRF_CLOUD_LOG_DIRECT=y
CONFIG_NRF_CLOUD_LOG_OUTPUT_LEVEL=3

# On initial connection to the cloud, add info sections to the shadow
CONFIG_NRF_CLOUD_SEND_DEVICE_STATUS=y
CONFIG_NRF_CLOUD_SEND_DEVICE_STATUS_NETWORK=y
CONFIG_NRF_CLOUD_SEND_DEVICE_STATUS_SIM=y
CONFIG_NRF_CLOUD_SEND_SERVICE_INFO_FOTA=y
CONFIG_NRF_CLOUD_SEND_SERVICE_INFO_UI=y

# Location tracking interval: 5 minutes (300 seconds)
CONFIG_LOCATION_TRACKING_SAMPLE_INTERVAL_SECONDS=300
```

## overlay_coap.conf
```kconfig
#
# Copyright (c) 2022 Nordic Semiconductor ASA
#
# SPDX-License-Identifier: LicenseRef-Nordic-5-Clause
#

# General config
CONFIG_FPU=y
CONFIG_NEWLIB_LIBC_NANO=n

# Rate of cloud interactions
# These are faster than one normally would use in a low power device.
# This is strictly for demo purposes.
CONFIG_SENSOR_SAMPLE_INTERVAL_SECONDS=120
CONFIG_LOCATION_TRACKING_SAMPLE_INTERVAL_SECONDS=300
CONFIG_COAP_FOTA_JOB_CHECK_RATE_MINUTES=2
CONFIG_COAP_SHADOW_CHECK_RATE_SECONDS=120

# Logs
CONFIG_LOG=y
CONFIG_NET_LOG=y
CONFIG_LOG_PRINTK=y
CONFIG_COAP_LOG_LEVEL_INF=y
CONFIG_LOCATION_LOG_LEVEL_INF=y
CONFIG_NRF_CLOUD_COAP_LOG_LEVEL_INF=y
CONFIG_MULTI_SERVICE_LOG_LEVEL_INF=y

# LTE link control - used by PGPS and main application
CONFIG_LTE_LINK_CONTROL=y

# Modem
CONFIG_MODEM_KEY_MGMT=y
CONFIG_MODEM_JWT=y
CONFIG_MODEM_INFO_ADD_DEVICE=y
CONFIG_MODEM_INFO_ADD_DATE_TIME=n
CONFIG_MODEM_INFO_ADD_SIM=n
CONFIG_MODEM_INFO_ADD_SIM_ICCID=n
CONFIG_MODEM_INFO_ADD_SIM_IMSI=n

# Network
CONFIG_POSIX_API=y
CONFIG_NET_SOCKETS_TLS_SET_MAX_FRAGMENT_LENGTH=y
CONFIG_NET_SOCKETS_OFFLOAD_PRIORITY=40

# CoAP Client
CONFIG_COAP_CLIENT_BLOCK_SIZE=1024
CONFIG_COAP_CLIENT_STACK_SIZE=2048
CONFIG_COAP_CLIENT_THREAD_PRIORITY=0
CONFIG_COAP_CLIENT_MAX_INSTANCES=3
# The extended options length must be increased to perform FOTA and P-GPS downloads over CoAP.
CONFIG_COAP_EXTENDED_OPTIONS_LEN_VALUE=192

# Not compatible with ground-fix
CONFIG_ZCBOR_CANONICAL=n

# nRF Cloud
CONFIG_NRF_CLOUD_MQTT=n
CONFIG_NRF_CLOUD_COAP=y
CONFIG_NRF_CLOUD_ALERT=y
CONFIG_NRF_CLOUD_LOG_DIRECT=y
CONFIG_NRF_CLOUD_LOG_OUTPUT_LEVEL=3
CONFIG_NRF_CLOUD_LOG_LOG_LEVEL_INF=y
CONFIG_NRF_CLOUD_FOTA_POLL=y

# Disable MQTT-specific services; equivalent CoAP versions are used instead.
CONFIG_NRF_CLOUD_FOTA=n
CONFIG_NRF_CLOUD_LOCATION=n

# Location Services configuration
CONFIG_LOCATION_DATA_DETAILS=y

# Sample configuration
CONFIG_APPLICATION_THREAD_STACK_SIZE=4096
CONFIG_TEMP_ALERT_LIMIT=24
```

## overlay_nrf700x_wifi_coap_no_lte.conf
```kconfig
#
# Copyright (c) 2024 Nordic Semiconductor ASA
#
# SPDX-License-Identifier: LicenseRef-Nordic-5-Clause
#

# Note that this overlay is not compatible with nrf91 Series! Use something such as the nrf5340 as
# the host microcontroller. It also requires the use of an _ns board / non-secure target.

## Disable Modem/LTE/nrf91-specific features
CONFIG_NRF_MODEM_LIB=n
CONFIG_MODEM_INFO=n
CONFIG_MODEM_INFO_ADD_NETWORK=n
CONFIG_AT_HOST_LIBRARY=n
CONFIG_LTE_LINK_CONTROL=n
CONFIG_LTE_PSM_REQ=n

## Disable offloaded sockets (we are going to switch to the native networking stack)
CONFIG_NET_SOCKETS_OFFLOAD=n

## Disable cloud features reliant on or specific to nrf91 modem features
CONFIG_NRF_CLOUD_AGNSS=n
CONFIG_NRF_CLOUD_PGPS=n
CONFIG_NRF_CLOUD_PGPS_REQUEST_UPON_INIT=n
CONFIG_LOCATION_METHOD_GNSS=n
CONFIG_LOCATION_METHOD_CELLULAR=n

## Disable FOTA to conserve memory
CONFIG_NRF_CLOUD_FOTA=n
CONFIG_COAP_FOTA=n
CONFIG_BOOTLOADER_MCUBOOT=n
CONFIG_IMG_MANAGER=n
CONFIG_MCUBOOT_IMG_MANAGER=n

## Enable TFM and Trusted Execution so that we can use Protected Storage for credentials storage.
## Please note that even when using Protected Storage, credentials are still retrieved into insecure
## memory when in use.
CONFIG_BUILD_WITH_TFM=y
CONFIG_TRUSTED_EXECUTION_NONSECURE=y

## Enable Protected Storage
CONFIG_TFM_PARTITION_PROTECTED_STORAGE=y

## Configure TFM Profile. The NOT_SET profile will enable all features.
## We then reduce some settings to save flash and RAM.
CONFIG_TFM_PROFILE_TYPE_NOT_SET=y
CONFIG_TFM_CRYPTO_CONC_OPER_NUM=4
CONFIG_TFM_CRYPTO_ASYM_SIGN_MODULE_ENABLED=n

## Configure TFM partitions
CONFIG_PM_PARTITION_SIZE_TFM_INTERNAL_TRUSTED_STORAGE=0x2000
CONFIG_PM_PARTITION_SIZE_TFM_OTP_NV_COUNTERS=0x2000
CONFIG_PM_PARTITION_SIZE_TFM_PROTECTED_STORAGE=0x4000
CONFIG_PM_PARTITION_SIZE_TFM_SRAM=0xC000
# This is larger than needed under normal conditions, but is the minimum size necessary to
# support enabling CONFIG_DEBUG_OPTIMIZATIONS (useful for debugging)
CONFIG_PM_PARTITION_SIZE_TFM=0x24000

## Configure credentials shells and dependencies
CONFIG_SHELL=y
CONFIG_WIFI_CREDENTIALS_SHELL=y
CONFIG_TLS_CREDENTIALS_SHELL=y
CONFIG_TLS_CREDENTIALS_BACKEND_PROTECTED_STORAGE=y
# Increased stack size needed for wifi_cred auto_connect command
CONFIG_SHELL_STACK_SIZE=4850
# nRFCloud credentials can exceed 1024 bytes
CONFIG_TLS_CREDENTIALS_SHELL_CRED_BUF_SIZE=3072
# Needed by the TLS credentials shell
CONFIG_BASE64=y

## Disable LTE-event-driven date_time updates (the date_time library will still periodically
## refresh its timestamp, this setting only controls whether LTE-event-driven date_time updates
## are enabled)
CONFIG_DATE_TIME_AUTO_UPDATE=n
CONFIG_DATE_TIME_MODEM=n
CONFIG_DATE_TIME_NTP=y
CONFIG_DATE_TIME_LOG_LEVEL_DBG=y

## Enable date_time retries for Wi-Fi
## This prevents occasional DNS lookup flukes from
## rendering the device unable to connect until the next
## CONFIG_DATE_TIME_UPDATE_INTERVAL_SECONDS elapses (default 4 hours)
CONFIG_DATE_TIME_RETRY_COUNT=5
# Use a really short retry interval for demo purposes
# 60 seconds to 15 minutes is probably more appropriate for
# real-world applications
CONFIG_DATE_TIME_RETRY_INTERVAL_SECONDS=20

## Disable LED patterns since the WiFi shield is not compatible
CONFIG_LED_INDICATION_DISABLED=y

## Disable LTE conn_mgr bindings
CONFIG_NRF_MODEM_LIB_NET_IF=n

## This had to be disabled for LTE with conn_mgr, but there is no reason to disable for Wi-Fi
CONFIG_DNS_RESOLVER=y
CONFIG_NET_SOCKETS_DNS_TIMEOUT=30000

## Enable Wi-Fi drivers, (and the native NET stack so that the location library can access them)
CONFIG_WIFI=y
CONFIG_WIFI_NRF70=y
CONFIG_WIFI_NRF70_SKIP_LOCAL_ADMIN_MAC=y

## Enable Wi-Fi conn_mgr bindings
CONFIG_L2_WIFI_CONNECTIVITY=y
CONFIG_NET_CONNECTION_MANAGER_MONITOR_STACK_SIZE=4850

## Enable WIFI_MGMT_EXT and WIFI_CREDENTIALS for simplified Wi-Fi connection setup
CONFIG_WIFI_CREDENTIALS=y
CONFIG_WIFI_MGMT_EXT=y

## Enable flash and NVS settings, required by WIFI_CREDENTIALS
CONFIG_SETTINGS=y
CONFIG_SETTINGS_NVS=y
CONFIG_NVS=y
CONFIG_FLASH=y
CONFIG_FLASH_PAGE_LAYOUT=y
CONFIG_FLASH_MAP=y

## Enable Wi-Fi networking and native networking stack
# Note: WIFI_NM_WPA_SUPPLICANT requires 24kB of unused RAM in the final build.
# Memory allocations in this overlay are fine-tuned with that fact in mind.
CONFIG_WIFI_NM_WPA_SUPPLICANT=y
CONFIG_NET_L2_ETHERNET=y
CONFIG_NET_NATIVE=y
CONFIG_NRF_SECURITY=y
CONFIG_NET_SOCKETS_SOCKOPT_TLS=y
CONFIG_NET_CONTEXT_SNDTIMEO=y
CONFIG_NET_TCP=y
CONFIG_NET_DHCPV4=y

## Configure native MBEDTLS
CONFIG_MQTT_LIB_TLS=n
CONFIG_MBEDTLS=y
CONFIG_MBEDTLS_ENABLE_HEAP=y
CONFIG_MBEDTLS_RSA_C=y
CONFIG_MBEDTLS_SSL_SERVER_NAME_INDICATION=y
CONFIG_MBEDTLS_HEAP_SIZE=80000
CONFIG_MBEDTLS_DTLS=y
CONFIG_MBEDTLS_SSL_SRV_C=y
CONFIG_MBEDTLS_SSL_COOKIE_C=y
CONFIG_MBEDTLS_SSL_DTLS_HELLO_VERIFY=y
CONFIG_MBEDTLS_SSL_DTLS_CONNECTION_ID=y
CONFIG_NET_SOCKETS_ENABLE_DTLS=y

## Disable unneeded MBEDTLS features to save flash and RAM
CONFIG_MBEDTLS_CHACHA20_C=n
CONFIG_MBEDTLS_CHACHA20_C=n
CONFIG_MBEDTLS_CHACHAPOLY_C=n
CONFIG_MBEDTLS_POLY1305_C=n
CONFIG_MBEDTLS_SHA1_C=n
CONFIG_MBEDTLS_MAC_SHA256_ENABLED=n
CONFIG_MBEDTLS_CIPHER_MODE_CBC=n

## Enable Wi-Fi location tracking
CONFIG_LOCATION_TRACKING_WIFI=y
CONFIG_LOCATION_METHOD_WIFI=y
# Keep CONFIG_NRF_WIFI_SCAN_MAX_BSS_CNT and CONFIG_LOCATION_METHOD_WIFI_SCANNING_RESULTS_MAX_CNT
# set to the same value.
CONFIG_NRF_WIFI_SCAN_MAX_BSS_CNT=10
CONFIG_LOCATION_METHOD_WIFI_SCANNING_RESULTS_MAX_CNT=10
# Add 256 bytes for each additional scanning result, assuming sane SSID lengths
CONFIG_HEAP_MEM_POOL_SIZE=153000
CONFIG_HEAP_MEM_POOL_IGNORE_MIN=y

## Miscellaneous resource allocation tweaks needed to support Wi-Fi.
CONFIG_MAIN_STACK_SIZE=2048
CONFIG_SYSTEM_WORKQUEUE_STACK_SIZE=4096
CONFIG_NET_MGMT_EVENT_QUEUE_SIZE=30
CONFIG_APPLICATION_THREAD_STACK_SIZE=3072
CONFIG_MESSAGE_THREAD_STACK_SIZE=3072
CONFIG_CONNECTION_THREAD_STACK_SIZE=4500
CONFIG_DATE_TIME_THREAD_STACK_SIZE=2048
CONFIG_NET_TX_STACK_SIZE=2048
CONFIG_NET_RX_STACK_SIZE=2048
CONFIG_ZVFS_OPEN_MAX=16
CONFIG_NET_SOCKETS_POLL_MAX=8
CONFIG_NET_MGMT_EVENT_STACK_SIZE=4000

# nRF Cloud: CoAP
CONFIG_NRF_CLOUD_MQTT=n
CONFIG_NRF_CLOUD_COAP=y
CONFIG_NRF_CLOUD_ALERT=y
CONFIG_NRF_CLOUD_LOCATION=n
CONFIG_NRF_CLOUD_JWT_SOURCE_CUSTOM=y
CONFIG_NRF_CLOUD_CLIENT_ID_SRC_COMPILE_TIME=y
# User must set their compile time client ID
CONFIG_NRF_CLOUD_CLIENT_ID=""

# General config
CONFIG_FPU=y
CONFIG_NEWLIB_LIBC_NANO=n

# Rate of cloud interactions
# These are faster than one normally would use in a low power device.
# This is strictly for demo purposes.
CONFIG_SENSOR_SAMPLE_INTERVAL_SECONDS=120
CONFIG_LOCATION_TRACKING_SAMPLE_INTERVAL_SECONDS=300

# Logs
CONFIG_LOG=y
CONFIG_NET_LOG=y
CONFIG_LOG_PRINTK=y
CONFIG_COAP_LOG_LEVEL_INF=y
CONFIG_LOCATION_LOG_LEVEL_INF=y
CONFIG_MULTI_SERVICE_LOG_LEVEL_INF=y

# LTE link control - used by main application
CONFIG_LTE_LINK_CONTROL=n

# Modem
CONFIG_MODEM_KEY_MGMT=n
CONFIG_MODEM_JWT=n
CONFIG_MODEM_INFO_ADD_DEVICE=n
CONFIG_MODEM_INFO_ADD_DATE_TIME=n
CONFIG_MODEM_INFO_ADD_SIM=n
CONFIG_MODEM_INFO_ADD_SIM_ICCID=n
CONFIG_MODEM_INFO_ADD_SIM_IMSI=n

# Network
CONFIG_POSIX_API=y
CONFIG_NET_SOCKETS_TLS_SET_MAX_FRAGMENT_LENGTH=y
CONFIG_NET_SOCKETS_OFFLOAD_PRIORITY=40

# CoAP Client
CONFIG_COAP_CLIENT_BLOCK_SIZE=1024
CONFIG_COAP_CLIENT_STACK_SIZE=6144
CONFIG_COAP_CLIENT_THREAD_PRIORITY=0
CONFIG_COAP_EXTENDED_OPTIONS_LEN_VALUE=40

# Location Services configuration
CONFIG_LOCATION_DATA_DETAILS=n

CONFIG_APPLICATION_THREAD_STACK_SIZE=8192
CONFIG_TEMP_ALERT_LIMIT=24

CONFIG_AT_MONITOR=n

# Disabling to prevent IPv6 error logs
CONFIG_NET_IPV6=n
```

## src/application.c
```c
/* Copyright (c) 2023 Nordic Semiconductor ASA
 *
 * SPDX-License-Identifier: LicenseRef-Nordic-5-Clause
 */

#include <zephyr/kernel.h>
#include <zephyr/logging/log.h>
#include <zephyr/logging/log_ctrl.h>
#include <helpers/nrfx_reset_reason.h>
#include <date_time.h>
#include <stdio.h>
#include <net/nrf_cloud.h>
#include <net/nrf_cloud_codec.h>
#include <net/nrf_cloud_log.h>
#include <net/nrf_cloud_alert.h>
#if defined(CONFIG_NRF_CLOUD_COAP)
#include <net/nrf_cloud_coap.h>
#endif
#if defined(CONFIG_LOCATION_TRACKING)
#include <modem/location.h>
#include "location_tracking.h"
#endif
#include <dk_buttons_and_leds.h>
#include "application.h"
#include "temperature.h"
#include "cloud_connection.h"
#include "message_queue.h"
#include "led_control.h"
#include "at_commands.h"
#include "shadow_config.h"
#include <nrf_modem_at.h>

LOG_MODULE_REGISTER(application, CONFIG_MULTI_SERVICE_LOG_LEVEL);

void configure_apn(void)
{
	int err;
	int retries = 0;
	char buf[64];

	LOG_INF("Configuring APN for IIJ Mobile...");

	/* Wait for modem to be ready before sending AT commands */
	while (retries < 10) {
		err = nrf_modem_at_cmd(buf, sizeof(buf), "AT+CGDCONT=0,\"IP\",\"iijmobile.biz\"");
		if (err == 0) {
			break;
		}
		LOG_DBG("Waiting for modem ready, attempt %d, err: %d", retries + 1, err);
		k_sleep(K_SECONDS(1));
		retries++;
	}

	if (err != 0) {
		LOG_ERR("Failed to set APN after %d retries, error: %d", retries, err);
		return;
	}

	err = nrf_modem_at_cmd(buf, sizeof(buf), "AT+CGAUTH=0,1,\"mobile@iij\",\"iij\"");
	if (err) {
		LOG_ERR("Failed to set APN auth, error: %d", err);
	}

	/* Restart modem to apply APN settings */
	err = nrf_modem_at_cmd(buf, sizeof(buf), "AT+CFUN=4");
	if (err) {
		LOG_ERR("Failed to set CFUN=4, error: %d", err);
	}

	err = nrf_modem_at_cmd(buf, sizeof(buf), "AT+CFUN=1");
	if (err) {
		LOG_ERR("Failed to set CFUN=1, error: %d", err);
	}

	LOG_INF("APN configuration complete");
}

/* Timer used to time the sensor sampling rate. */
static K_TIMER_DEFINE(sensor_sample_timer, NULL, NULL);

/* Timer for battery charging period (24 hours) */
static void battery_timer_callback(struct k_timer *timer_id);
static K_TIMER_DEFINE(battery_timer, battery_timer_callback, NULL);

/* AT command request error handling */
#define AT_CMD_REQUEST_ERR_FORMAT "Error while processing AT command request: %d"
#define AT_CMD_REQUEST_ERR_MAX_LEN (sizeof(AT_CMD_REQUEST_ERR_FORMAT) + 20)
BUILD_ASSERT(CONFIG_AT_CMD_REQUEST_RESPONSE_BUFFER_LENGTH >= AT_CMD_REQUEST_ERR_MAX_LEN,
	     "Not enough AT command response buffer for printing error events.");

/* Temperature alert limits. */
#define TEMP_ALERT_LIMIT ((double)CONFIG_TEMP_ALERT_LIMIT)
#define TEMP_ALERT_HYSTERESIS 1.5
#define TEMP_ALERT_LOWER_LIMIT (TEMP_ALERT_LIMIT - TEMP_ALERT_HYSTERESIS)

/* State of the test counter. This can be changed using the configuration in the shadow */
static bool test_counter_enabled;

/* Current location tracking interval in seconds */
static int current_location_interval = CONFIG_LOCATION_TRACKING_SAMPLE_INTERVAL_SECONDS;

/**
 * @brief Construct a device message object with automatically generated timestamp
 *
 * The resultant JSON object will be conformal to the General Message Schema described in the
 * application-protocols repo:
 *
 * https://github.com/nRFCloud/application-protocols
 *
 * @param msg - The object to contain the message
 * @param appid - The appId for the device message
 * @param msg_type - The messageType for the device message
 * @return int - 0 on success, negative error code otherwise.
 */
static int create_timestamped_device_message(struct nrf_cloud_obj *const msg,
					     const char *const appid,
					     const char *const msg_type)
{
	int err;
	int64_t timestamp;

	/* Acquire timestamp */
	err = date_time_now(&timestamp);
	if (err) {
		LOG_ERR("Failed to obtain current time, error %d", err);
		return -ETIME;
	}

	/* Create message object */
	err = nrf_cloud_obj_msg_init(msg, appid,
				     IS_ENABLED(CONFIG_NRF_CLOUD_COAP) ? NULL : msg_type);
	if (err) {
		LOG_ERR("Failed to initialize message with appid %s and msg type %s",
			appid, msg_type);
		return err;
	}

	/* Add timestamp to message object */
	err = nrf_cloud_obj_ts_add(msg, timestamp);
	if (err) {
		LOG_ERR("Failed to add timestamp to data message with appid %s and msg type %s",
			appid, msg_type);
		nrf_cloud_obj_free(msg);
		return err;
	}

	return 0;
}

/**
 * @brief Transmit a collected sensor sample to nRF Cloud.
 *
 * @param sensor - The name of the sensor which was sampled.
 * @param value - The sampled sensor value.
 * @return int - 0 on success, negative error code otherwise.
 */
static int send_sensor_sample(const char *const sensor, double value)
{
	int ret;

	MSG_OBJ_DEFINE(msg_obj);

	/* Create a timestamped message container object for the sensor sample. */
	ret = create_timestamped_device_message(&msg_obj, sensor,
						NRF_CLOUD_JSON_MSG_TYPE_VAL_DATA);
	if (ret) {
		return -EINVAL;
	}

	/* Populate the container object with the sensor value. */
	ret = nrf_cloud_obj_num_add(&msg_obj, NRF_CLOUD_JSON_DATA_KEY, value, false);
	if (ret) {
		LOG_ERR("Failed to append value to %s sample container object ",
			sensor);
		nrf_cloud_obj_free(&msg_obj);
		return -ENOMEM;
	}

	/* Send the sensor sample container object as a device message. */
	return send_device_message(&msg_obj);
}

#if defined(CONFIG_LOCATION_TRACKING)
/**
 * @brief Transmit a collected GNSS sample to nRF Cloud.
 *
 * @param loc_gnss - GNSS location data.
 * @return int - 0 on success, negative error code otherwise.
 */
static int send_gnss(const struct location_event_data * const loc_gnss)
{
	int ret;

	if (!loc_gnss || (loc_gnss->method != LOCATION_METHOD_GNSS)) {
		return -EINVAL;
	}

	struct nrf_cloud_gnss_data gnss_pvt = {
		.type = NRF_CLOUD_GNSS_TYPE_PVT,
		.ts_ms = NRF_CLOUD_NO_TIMESTAMP,
		.pvt = {
			.lon		= loc_gnss->location.longitude,
			.lat		= loc_gnss->location.latitude,
			.accuracy	= loc_gnss->location.accuracy,
			.has_alt	= 0,
			.has_speed	= 0,
			.has_heading	= 0
		}
	};
	MSG_OBJ_DEFINE(msg_obj);

	/* Add the timestamp */
	(void)date_time_now(&gnss_pvt.ts_ms);

	/* Encode the location data into a device message */
	ret = nrf_cloud_obj_gnss_msg_create(&msg_obj, &gnss_pvt);

	if (ret == 0) {
		/* Send the location message */
		ret = send_device_message(&msg_obj);
	}

	return ret;
}

/**
 * @brief Callback to receive periodic location updates from location_tracking.c and forward them
 * to nRF Cloud.
 *
 * Note that cellular positioning (MCELL/Multi-Cell and SCELL/Single-Cell) is sent to nRF
 * Cloud automatically (since the Location library and nRF Cloud must work together to
 * determine them in the first place). GNSS positions, on the other hand, must be
 * sent manually, since they are determined entirely on-device.
 *
 * @param location_data - The received location update.
 *
 */
static void on_location_update(const struct location_event_data * const location_data)
{
	LOG_INF("Location Updated: %.06f N %.06f W, accuracy: %.01f m, Method: %s",
		location_data->location.latitude,
		location_data->location.longitude,
		(double)location_data->location.accuracy,
		location_method_str(location_data->method));

	/* If the position update was derived using GNSS, send it onward to nRF Cloud. */
	if (location_data->method == LOCATION_METHOD_GNSS) {
		LOG_INF("GNSS Position Update! Sending to nRF Cloud...");
		send_gnss(location_data);
	}
}
#endif /* CONFIG_LOCATION_TRACKING */

/**
 * @brief Receives general device messages from nRF Cloud, checks if they are AT command requests,
 * and performs them if so, transmitting the modem response back to nRF Cloud.
 *
 * Try sending {"appId":"MODEM", "messageType":"CMD", "data":"AT+CGMR"}
 * in the nRF Cloud Portal Terminal card.
 *
 * @param msg - The device message to check.
 */
static void handle_at_cmd_requests(const struct nrf_cloud_data *const dev_msg)
{
	char *cmd;
	struct nrf_cloud_obj msg_obj;
	int err = nrf_cloud_obj_input_decode(&msg_obj, dev_msg);

	if (err) {
		/* The message isn't JSON or otherwise couldn't be parsed. */
		LOG_DBG("A general topic device message of length %d could not be parsed.",
			dev_msg->len);
		return;
	}

	/* Confirm app ID and message type */
	err = nrf_cloud_obj_msg_check(&msg_obj, NRF_CLOUD_JSON_APPID_VAL_MODEM,
				      NRF_CLOUD_JSON_MSG_TYPE_VAL_CMD);
	if (err) {
		goto cleanup;
	}

	/* Get the command string */
	err = nrf_cloud_obj_str_get(&msg_obj, NRF_CLOUD_JSON_DATA_KEY, &cmd);
	if (err) {
		/* Missing or invalid command value will be treated as a blank command */
		cmd = "";
	}

	/* Execute the command and receive the result */
	char *response = execute_at_cmd_request(cmd);

	/* To re-use msg_obj for the response message we must first free its memory and
	 * reset its state.
	 * The cmd string will no longer be valid after msg_obj is freed.
	 */
	cmd = NULL;
	/* Free the object's allocated memory */
	err = nrf_cloud_obj_free(&msg_obj);
	if (err) {
		LOG_ERR("Failed to free AT CMD request");
		return;
	}

	/* Reset the object's state */
	err = nrf_cloud_obj_reset(&msg_obj);
	if (err) {
		LOG_ERR("Failed to reset AT CMD request message object for reuse");
		return;
	}

	err = create_timestamped_device_message(&msg_obj, NRF_CLOUD_JSON_APPID_VAL_MODEM,
						NRF_CLOUD_JSON_MSG_TYPE_VAL_DATA);
	if (err) {
		return;
	}

	/* Populate response with command result */
	err = nrf_cloud_obj_str_add(&msg_obj, NRF_CLOUD_JSON_DATA_KEY, response, false);
	if (err) {
		LOG_ERR("Failed to populate AT CMD response with modem response data");
		goto cleanup;
	}

	/* Send the response */
	err = send_device_message(&msg_obj);
	if (err) {
		LOG_ERR("Failed to send AT CMD request response, error: %d", err);
	}

	return;

cleanup:
	(void)nrf_cloud_obj_free(&msg_obj);
}

/** @brief Check whether temperature is acceptable.
 * If the device exceeds a temperature limit, send the temperature alert one time.
 * Once the temperature falls below a lower limit, re-enable the temperature alert
 * so it will be sent if limit is exceeded again.
 *
 * The difference between the two limits should be sufficient to prevent sending
 * new alerts if the temperature value oscillates between two nearby values.
 *
 * @param temp - The current device temperature.
 */
static void monitor_temperature(double temp)
{
	static bool temperature_alert_active;

	if ((temp > TEMP_ALERT_LIMIT) && !temperature_alert_active) {
		temperature_alert_active = true;
		(void)nrf_cloud_alert_send(ALERT_TYPE_TEMPERATURE, (float)temp,
					   "Temperature over limit!");
		LOG_INF("Temperature limit %f C exceeded: now %f C.",
			TEMP_ALERT_LIMIT, temp);
	} else if ((temp < TEMP_ALERT_LOWER_LIMIT) && temperature_alert_active) {
		temperature_alert_active = false;
		LOG_INF("Temperature now below limit: %f C.", temp);
	}
}

/** @brief Send an incrementing test counter message to nRF Cloud.
 * If CONFIG_TEST_COUNTER_MULTIPLIER is greater than 1, the counter will be incremented
 * that many times in a row, and a separate test counter message will be sent for each increment.
 */
static void test_counter_send(void)
{
	static int counter;

	for (int i = 0; i < CONFIG_TEST_COUNTER_MULTIPLIER; i++) {
		LOG_INF("Sent test counter = %d", counter);
		(void)send_sensor_sample("COUNT", counter++);
	}
}

static void button_handler(uint32_t button_state, uint32_t has_changed)
{
	if (has_changed & DK_BTN1_MSK) {
		if ((button_state & DK_BTN1_MSK) == DK_BTN1_MSK) {
			LOG_INF("Button pressed");
			(void)nrf_cloud_alert_send(ALERT_TYPE_MSG, 0, "Button pressed");
		}
	}
}

static void print_reset_reason(void)
{
	uint32_t reset_reason;

	reset_reason = nrfx_reset_reason_get();
	LOG_INF("Reset reason: 0x%x", reset_reason);
}

static void report_startup(void)
{
	if (IS_ENABLED(CONFIG_SEND_ONLINE_ALERT)) {
		uint32_t reset_reason;

		reset_reason = nrfx_reset_reason_get();
		nrfx_reset_reason_clear(reset_reason);
		(void)nrf_cloud_alert_send(ALERT_TYPE_DEVICE_NOW_ONLINE, reset_reason, NULL);
	}
}

void main_application_thread_fn(void)
{
	print_reset_reason();

	if (IS_ENABLED(CONFIG_AT_CMD_REQUESTS)) {
		/* Register with connection.c to receive general device messages and check them for
		 * AT command requests.
		 */
		register_general_dev_msg_handler(handle_at_cmd_requests);
	}

	dk_buttons_init(button_handler);

	/* Wait for first connection before starting the application. */
	(void)await_cloud_ready(K_FOREVER);

	report_startup();

	/* Wait for the date and time to become known.
	 * This is needed both for location services and for sensor sample timestamping.
	 */
	LOG_INF("Waiting for modem to determine current date and time");
	if (!await_date_time_known(K_SECONDS(CONFIG_DATE_TIME_ESTABLISHMENT_TIMEOUT_SECONDS))) {
		LOG_WRN("Failed to determine valid date time. Proceeding anyways");
	} else {
		LOG_INF("Current date and time determined");
	}

	const char *protocol = "";

	if (IS_ENABLED(CONFIG_NRF_CLOUD_MQTT)) {
		protocol = "MQTT";
	} else if (IS_ENABLED(CONFIG_NRF_CLOUD_COAP)) {
		protocol = "CoAP";
	}
	nrf_cloud_log_init();
	nrf_cloud_log_control_set(CONFIG_NRF_CLOUD_LOG_OUTPUT_LEVEL);
	/* Send a direct log to the nRF Cloud web portal indicating the sample has started up. */
	(void)nrf_cloud_log_send(LOG_LEVEL_INF,
				 "nRF Cloud multi-service sample has started, "
				 "version: %s, protocol: %s",
				 CONFIG_APP_VERSION, protocol);

#if defined(CONFIG_LOCATION_TRACKING)
	/* Begin tracking location at the configured interval. */
	int err = start_location_tracking(on_location_update,
					CONFIG_LOCATION_TRACKING_SAMPLE_INTERVAL_SECONDS);
	if (err) {
		LOG_ERR("Failed to start location tracking: %d", err);
	} else {
		/* Start the 24-hour battery timer only if location tracking started successfully */
		k_timer_start(&battery_timer, K_SECONDS(24 * 3600), K_FOREVER);
	}
#endif

	/* Begin sampling sensors. */
	while (true) {
		/* Start the sensor sample interval timer.
		 * We use a timer here instead of merely sleeping the thread, because the
		 * application thread can be preempted by other threads performing long tasks
		 * (such as periodic location acquisition), and we want to account for these
		 * delays when metering the sample send rate.
		 */
		k_timer_start(&sensor_sample_timer,
			K_SECONDS(CONFIG_SENSOR_SAMPLE_INTERVAL_SECONDS), K_FOREVER);

		if (IS_ENABLED(CONFIG_TEMP_TRACKING)) {
			double temp = -1;

			if (get_temperature(&temp) == 0) {
				LOG_INF("Temperature is %d degrees C", (int)temp);
				(void)send_sensor_sample(NRF_CLOUD_JSON_APPID_VAL_TEMP, temp);

				monitor_temperature(temp);
			}
		}

		if (test_counter_enable_get()) {
			test_counter_send();
		}

		/* Wait out any remaining time on the sample interval timer. */
		k_timer_status_sync(&sensor_sample_timer);

		/* If cloud stops being ready due to network trouble or device being deleted
		 * from the cloud, turn off sensors and wait, then restart sensors.
		 */
		if (!await_cloud_ready(K_NO_WAIT) && is_device_deleted()) {
#if defined(CONFIG_LOCATION_TRACKING)
			(void)location_request_cancel();
			k_timer_stop(&battery_timer);
#endif
			LOG_INF("Cloud not ready. Pausing sensors.");
			(void)await_cloud_ready(K_FOREVER);
			LOG_INF("Cloud is ready. Enabling sensors.");
#if defined(CONFIG_LOCATION_TRACKING)
			/* Begin tracking location at the configured interval. */
			int err = start_location_tracking(on_location_update,
						  CONFIG_LOCATION_TRACKING_SAMPLE_INTERVAL_SECONDS);
			if (err) {
				LOG_ERR("Failed to restart location tracking: %d", err);
			} else {
				/* Restart the 24-hour battery timer */
				k_timer_start(&battery_timer, K_SECONDS(24 * 3600), K_FOREVER);
			}
#endif
		}
	}
}

static void battery_timer_callback(struct k_timer *timer_id)
{
	/* After 24 hours, change location interval to 20 minutes (1200 seconds) */
	location_interval_set(1200);
	LOG_INF("Battery charging period ended, location interval changed to 20 minutes");
}

void test_counter_enable_set(const bool enable)
{
	if (IS_ENABLED(CONFIG_TEST_COUNTER)) {
		LOG_DBG("CONFIG_TEST_COUNTER is enabled, ignoring state change request");
	} else {
		LOG_DBG("Test counter %s", enable ? "enabled" : "disabled");
		test_counter_enabled = enable;
	}
}

bool test_counter_enable_get(void)
{
	/* When CONFIG_TEST_COUNTER is enabled the test counter is always enabled */
	return (test_counter_enabled || IS_ENABLED(CONFIG_TEST_COUNTER));
}

void location_interval_set(const int interval)
{
	if (interval > 0) {
		current_location_interval = interval;
#if defined(CONFIG_LOCATION_TRACKING)
		/* Only update if location tracking is initialized */
		if (is_location_tracking_initialized()) {
			/* Update the location tracking interval */
			int err = update_location_tracking_interval(interval);
			if (err) {
				LOG_WRN("Failed to update location tracking interval: %d", err);
			}
		} else {
			LOG_DBG("Location tracking not yet initialized, interval will be applied on startup");
		}
#endif
	}
}

int location_interval_get(void)
{
	return current_location_interval;
}
```

## src/application.h
```c
/* Copyright (c) 2023 Nordic Semiconductor ASA
 *
 * SPDX-License-Identifier: LicenseRef-Nordic-5-Clause
 */

#ifndef _APPLICATION_H_
#define _APPLICATION_H_

#if defined(CONFIG_NRF_CLOUD_MQTT)
#define MSG_OBJ_DEFINE(_obj_name) \
	NRF_CLOUD_OBJ_JSON_DEFINE(_obj_name);
#elif defined(CONFIG_NRF_CLOUD_COAP)
#define MSG_OBJ_DEFINE(_obj_name) \
	NRF_CLOUD_OBJ_COAP_CBOR_DEFINE(_obj_name);
#endif

/**
 * @brief Main application -- Wait for valid connection, start location tracking, and then
 * periodically sample sensors and send them to nRF Cloud.
 */
void configure_apn(void);
void main_application_thread_fn(void);

void test_counter_enable_set(const bool enable);
bool test_counter_enable_get(void);

void location_interval_set(const int interval);
int location_interval_get(void);

#endif /* _APPLICATION_H_ */
```

## src/location_tracking.c
```c
/* Copyright (c) 2022 Nordic Semiconductor ASA
 *
 * SPDX-License-Identifier: LicenseRef-Nordic-5-Clause
 */


#include <zephyr/kernel.h>
#include <zephyr/logging/log.h>
#include <zephyr/sys/util.h>
#include <modem/location.h>
#include <date_time.h>
#include <modem/lte_lc.h>

#include "cloud_connection.h"
#include "location_tracking.h"

LOG_MODULE_REGISTER(location_tracking, CONFIG_MULTI_SERVICE_LOG_LEVEL);

static location_update_cb_t location_update_handler;
static bool location_initialized;
static struct location_config current_config;

static void location_event_handler(const struct location_event_data *event_data)
{
	switch (event_data->id) {
	case LOCATION_EVT_LOCATION:
		LOG_DBG("Location Event: Got location");
		if (location_update_handler) {
			/* Pass received location data along to our handler. */
			location_update_handler(event_data);
		}
		break;

	case LOCATION_EVT_TIMEOUT:
		LOG_DBG("Location Event: Timed out");
		if (event_data->method != LOCATION_METHOD_GNSS) {
			/* GNSS can timeout due to obstructed satellite signals. Other methods
			 * timeout when there is a communications error with the cloud.
			 */
			cloud_transport_error_detected();
		}
		break;

	case LOCATION_EVT_ERROR:
		LOG_DBG("Location Event: Error");
		break;

	case LOCATION_EVT_GNSS_ASSISTANCE_REQUEST:
		LOG_DBG("Location Event: GNSS assistance requested");
		break;

	case LOCATION_EVT_STARTED:
		break;

	default:
		LOG_DBG("Location Event: Unknown event");
		break;
	}
}

static void enable_modem_gnss(void)
{
	if (IS_ENABLED(CONFIG_LTE_LINK_CONTROL)) {
		int err = lte_lc_func_mode_set(LTE_LC_FUNC_MODE_ACTIVATE_GNSS);

		if (err) {
			LOG_ERR("Activating GNSS failed, error: %d. Continuing without GNSS", err);
		}
	} else {
		LOG_WRN("CONFIG_LTE_LINK_CONTROL must be enabled in order to use GNSS");
	}
}

int start_location_tracking(location_update_cb_t handler_cb, int interval)
{
	int err;

	LOG_DBG("Starting location tracking");

	if (!date_time_is_valid()) {
		LOG_WRN("Date and time unknown. Location Services results may suffer");
	}

	/* Enable GNSS on the modem if appropriate */
	if (IS_ENABLED(CONFIG_LOCATION_TRACKING_GNSS)) {
		enable_modem_gnss();
	}

	/* Update the location update handler. */
	location_update_handler = handler_cb;

	/* Initialize the Location Services Library. */
	err = location_init(location_event_handler);
	if (err) {
		LOG_ERR("Initializing the Location library failed, error: %d", err);
		return err;
	}
	location_initialized = true;

	/* Construct a request for a periodic location report. */
	struct location_config config;

	/* Select methods based on configuration and load default settings */
	/* Methods will be attempted in the order they are listed here */
	enum location_method methods[] = {
		IF_ENABLED(CONFIG_LOCATION_TRACKING_GNSS,	(LOCATION_METHOD_GNSS,))
		IF_ENABLED(CONFIG_LOCATION_TRACKING_WIFI,	(LOCATION_METHOD_WIFI,))
		IF_ENABLED(CONFIG_LOCATION_TRACKING_CELLULAR,	(LOCATION_METHOD_CELLULAR,))
	};

	if (IS_ENABLED(CONFIG_LOCATION_TRACKING_GNSS)) {
		LOG_DBG("Selected the GNSS location tracking method.");
	}
	if (IS_ENABLED(CONFIG_LOCATION_TRACKING_WIFI)) {
		LOG_DBG("Selected the Wi-Fi location tracking method.");
	}
	if (IS_ENABLED(CONFIG_LOCATION_TRACKING_CELLULAR)) {
		LOG_DBG("Selected the Cellular location tracking method.");
	}
	if (ARRAY_SIZE(methods) == 0) {
		LOG_DBG("No positioning methods selected");
		return 0;
	}

	/* Load default settings accordingly */
	location_config_defaults_set(&config, ARRAY_SIZE(methods), methods);

	/* Set the mode to walk through all methods. This ensures all methods
	 * are tested and demonstrated.
	 * In a real product, the default is the better option to use, since the location
	 * library will try them in priority order.
	 */
	config.mode = LOCATION_REQ_MODE_ALL;

	/* Set the location report interval. */
	config.interval = interval;

	/* If GNSS location method is enabled, configure it
	 * (note: the GNSS location method is enabled by default in this sample)
	 */
	if (IS_ENABLED(CONFIG_LOCATION_TRACKING_GNSS)) {
		/* Set the GNSS timeout and desired accuracy.
		 * The order of config.methods matches the order of methods, so GNSS will always be
		 * the first element of the array if enabled.
		 */
		config.methods[0].gnss.timeout = CONFIG_GNSS_FIX_TIMEOUT_SECONDS * MSEC_PER_SEC;
		config.methods[0].gnss.accuracy = LOCATION_ACCURACY_NORMAL;
	}

	/* Submit request for periodic location report.
	 * This will cause the configured location_event_handler to start being called with
	 * location data.
	 */
	err = location_request(&config);
	if (err) {
		LOG_ERR("Requesting location failed, error: %d\n", err);
		return err;
	}

	/* Save the current config for future updates */
	current_config = config;

	return 0;
}

int update_location_tracking_interval(int interval)
{
	int err;

	if (!location_initialized) {
		LOG_ERR("Location tracking not initialized");
		return -EINVAL;
	}

	/* Update the interval */
	current_config.interval = interval;

	/* Submit new request with updated config */
	err = location_request(&current_config);
	if (err) {
		LOG_ERR("Requesting location with new interval failed, error: %d", err);
		return err;
	}

	return 0;
}

bool is_location_tracking_initialized(void)
{
	return location_initialized;
}
```

## src/location_tracking.h
```c
/* Copyright (c) 2022 Nordic Semiconductor ASA
 *
 * SPDX-License-Identifier: LicenseRef-Nordic-5-Clause
 */

#ifndef _LOCATION_TRACKING_H_
#define _LOCATION_TRACKING_H_

/* Definition found in location.h */
struct location_event_data;

/**
 * @brief Callback to receive tracked locations.
 *
 * @param[in] location_data The tracked location data.
 */
typedef void (*location_update_cb_t)(const struct location_event_data * const location_data);

/**
 * @brief Start tracking our location at the given interval in seconds.
 *
 * @param handler_cb - Handler callback to receive location updates.
 * @param interval - The interval, in seconds, at which to track our location.
 */
int start_location_tracking(location_update_cb_t handler_cb, int interval);

/**
 * @brief Update the location tracking interval.
 *
 * @param interval - The new interval, in seconds.
 */
int update_location_tracking_interval(int interval);

/**
 * @brief Check if location tracking is initialized.
 *
 * @return true if initialized, false otherwise.
 */
bool is_location_tracking_initialized(void);

static inline bool location_tracking_enabled(void)
{
	return IS_ENABLED(CONFIG_LOCATION_TRACKING_GNSS) ||
	       IS_ENABLED(CONFIG_LOCATION_TRACKING_CELLULAR) ||
	       IS_ENABLED(CONFIG_LOCATION_TRACKING_WIFI);
}


#endif /* _LOCATION_TRACKING_H_ */
```

## src/shadow_config.c
```c
/* Copyright (c) 2024 Nordic Semiconductor ASA
 *
 * SPDX-License-Identifier: LicenseRef-Nordic-5-Clause
 */

#include <zephyr/kernel.h>
#include <zephyr/logging/log.h>
#include <zephyr/logging/log_ctrl.h>
#include <net/nrf_cloud_defs.h>

#include "shadow_config.h"
#if defined(CONFIG_NRF_CLOUD_COAP)
#include "shadow_support_coap.h"
#endif
#include "application.h"

LOG_MODULE_REGISTER(shadow_config, CONFIG_MULTI_SERVICE_LOG_LEVEL);

#define TEST_COUNTER_EN	"counterEnable"
#define LOCATION_INTERVAL "locationInterval"

/* Flag to indicate that the accepted shadow data has been received (MQTT only) */
static bool accepted_rcvd;

static int add_cfg_data(struct nrf_cloud_obj *const cfg_obj)
{
	int err;

	/* Add the test counter state */
	err = nrf_cloud_obj_bool_add(cfg_obj, TEST_COUNTER_EN, test_counter_enable_get(), false);
	if (err) {
		return err;
	}

	/* Add the location interval */
	return nrf_cloud_obj_num_add(cfg_obj, LOCATION_INTERVAL, location_interval_get(), false);
}

static int process_cfg(struct nrf_cloud_obj *const cfg_obj)
{
	bool val;
	double num_val;
	int err = nrf_cloud_obj_bool_get(cfg_obj, TEST_COUNTER_EN, &val);

	if (err == 0) {
		/* The expected key/value was found, set the test counter enable state */
		test_counter_enable_set(val);
	} else if (err == -ENOMSG) {
		/* The key was found, but the value was not a boolean */
		LOG_WRN("Invalid configuration value");
		/* Reject the config */
		err = -EBADF;
	} else {
		LOG_DBG("Expected data not found in config object");
		err = -ENOMSG;
	}

	/* Process location interval */
	int err2 = nrf_cloud_obj_num_get(cfg_obj, LOCATION_INTERVAL, &num_val);
	if (err2 == 0) {
		location_interval_set((int)num_val);
	} else if (err2 == -ENOMSG) {
		/* Not found, ignore */
	} else {
		LOG_WRN("Invalid location interval value");
		if (err == 0) {
			err = -EBADF;
		}
	}

	return err;
}

static int send_config(void)
{
	int err;

	NRF_CLOUD_OBJ_JSON_DEFINE(root_obj);
	NRF_CLOUD_OBJ_JSON_DEFINE(state_obj);
	NRF_CLOUD_OBJ_JSON_DEFINE(reported_obj);
	NRF_CLOUD_OBJ_JSON_DEFINE(cfg_obj);

	if (nrf_cloud_obj_init(&cfg_obj) || nrf_cloud_obj_init(&reported_obj) ||
	    nrf_cloud_obj_init(&state_obj) || nrf_cloud_obj_init(&root_obj)) {
		err = -ENOMEM;
		goto cleanup;
	}

	/* Add the supported configuration data */
	err = add_cfg_data(&cfg_obj);
	if (err) {
		goto cleanup;
	}

#if defined(CONFIG_NRF_CLOUD_MQTT)

	/* Add config to reported */
	err = nrf_cloud_obj_object_add(&reported_obj, NRF_CLOUD_JSON_KEY_CFG, &cfg_obj, false);
	if (err) {
		goto cleanup;
	}

	/* Add reported to state */
	err = nrf_cloud_obj_object_add(&state_obj, NRF_CLOUD_JSON_KEY_REP, &reported_obj, false);
	if (err) {
		goto cleanup;
	}

	/* Add state to the root object */
	err = nrf_cloud_obj_object_add(&root_obj, NRF_CLOUD_JSON_KEY_STATE, &state_obj, false);
	if (err) {
		goto cleanup;
	}

	/* Send to the cloud */
	err = nrf_cloud_obj_shadow_update(&root_obj);
#else  /* CONFIG_NRF_CLOUD_COAP */

	/* Add config to root */
	err = nrf_cloud_obj_object_add(&root_obj, NRF_CLOUD_JSON_KEY_CFG, &cfg_obj, false);
	if (err) {
		goto cleanup;
	}

	err = shadow_support_coap_obj_send(&root_obj, false);
#endif

cleanup:
	nrf_cloud_obj_free(&root_obj);
	nrf_cloud_obj_free(&state_obj);
	nrf_cloud_obj_free(&reported_obj);
	nrf_cloud_obj_free(&cfg_obj);
	return err;
}

void shadow_config_cloud_connected(void)
{
	accepted_rcvd = false;
}

int shadow_config_reported_send(void)
{
	LOG_INF("Sending reported configuration");

	int err = send_config();

	if (err) {
		LOG_ERR("Failed to send configuration, error: %d", err);
	}

	return err;
}

int shadow_config_delta_process(struct nrf_cloud_obj *const delta_obj)
{
	if (!delta_obj) {
		return -EINVAL;
	}

	if ((delta_obj->type != NRF_CLOUD_OBJ_TYPE_JSON) || !delta_obj->json) {
		/* No state JSON */
		return -ENOMSG;
	}

	/* If there is a pending delta event when the device establishes a cloud connection
	 * it is possible that it will be received before the accepted shadow data.
	 * Do not process a delta event until the accepted shadow data has been received.
	 * This is only a concern for MQTT.
	 */
	if (!accepted_rcvd && IS_ENABLED(CONFIG_NRF_CLOUD_MQTT)) {
		return -EAGAIN;
	}

	int err;

	NRF_CLOUD_OBJ_JSON_DEFINE(cfg_obj);

	/* Get the config object */
	err = nrf_cloud_obj_object_detach(delta_obj, NRF_CLOUD_JSON_KEY_CFG, &cfg_obj);
	if (err == -ENODEV) {
		/* No config in the delta */
		return -ENOMSG;
	}

	/* Process the configuration */
	err = process_cfg(&cfg_obj);

	if (err == -EBADF) {
		/* Clear incoming config and replace it with a good one */
		nrf_cloud_obj_free(&cfg_obj);
		nrf_cloud_obj_init(&cfg_obj);
		if (add_cfg_data(&cfg_obj)) {
			LOG_ERR("Failed to create delta response");
		}
	}

	/* Add the config object back into the state so the response can be sent */
	if (nrf_cloud_obj_object_add(delta_obj, NRF_CLOUD_JSON_KEY_CFG, &cfg_obj, false)) {
		nrf_cloud_obj_free(&cfg_obj);
		return -ENOMEM;
	}

	return err;
}

int shadow_config_accepted_process(struct nrf_cloud_obj *const accepted_obj)
{
	if (!accepted_obj) {
		return -EINVAL;
	}

	/* The accepted shadow has been received */
	accepted_rcvd = true;

	if ((accepted_obj->type != NRF_CLOUD_OBJ_TYPE_JSON) || !accepted_obj->json) {
		/* No config JSON */
		return -ENOMSG;
	}

	return process_cfg(accepted_obj);
}
```
